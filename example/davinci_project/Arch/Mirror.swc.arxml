AUTOSAR XML (schema 4.0)
package /Mirror
  sw component type MirrorHeater
    internal behavior ib_heat
      timing event ev_heat_1s: start-on-event=ru_heat, period=1.0
      runnable ru_heat: symbol=MirrorHeater_Cyclic1s
  port interface II_HEATER
    operation SetHeater
